## conf/layer.conf
```bitbake
# Layer configuration for meta-own-char-driver

BBPATH .= ":${LAYERDIR}"
BBFILES += "${LAYERDIR}/recipes-*/*/*.bb \
            ${LAYERDIR}/recipes-*/*/*.bbappend"

LAYERNAME = "meta-own-char-driver"

BBFILE_COLLECTIONS += "meta-own-char-driver"
BBFILE_PATTERN_meta-own-char-driver = "^${LAYERDIR}/"
BBFILE_PRIORITY_meta-own-char-driver = "6"
```
